## conf/layer.conf
```bitbake
#
# Wind River SBC8548e BSP Layer
#

BBPATH ?= ""

# We have a conf and classes directory, add to BBPATH
BBPATH := "${LAYERDIR}:${BBPATH}"

# We have a packages directory, add to BBFILES
BBFILES := "${BBFILES} ${LAYERDIR}/recipes-*/*/*.bb \
            ${LAYERDIR}/recipes-*/*/*.bbappend \
            ${LAYERDIR}/classes/*.bbclass"

BBFILE_COLLECTIONS         += "wrs-sbc8548"
BBFILE_PATTERN_wrs-sbc8548 := "^${LAYERDIR}/"
BBFILE_PRIORITY_wrs-sbc8548 = "7"

# Let the "No recipes available for: pkg.bbappend" be WARNINGS until we
# cleanup the unused bbappend.
BB_DANGLINGAPPENDS_WARNONLY ?= "true"

# This should only be incremented on significant changes that will
# cause compatibility issues with other layers
LAYERVERSION_wrs-sbc8548 = "1"

LAYERDEPENDS_wrs-sbc8548 = "core wr-kernel"
```

## conf/machine/wrs-sbc8548.conf
```bitbake
#@TYPE: Machine
#@NAME: Wind River SBC8548e
#@DESCRIPTION: Machine configuration for the Wind River wrs-sbc8548

require wrs-sbc8548.inc
```

## conf/machine/wrs-sbc8548.inc
```bitbake
#@TYPE: Machine inc.
#@NAME: Wind River SBC8548e configuration settings

# Use the standard kernel
PREFERRED_PROVIDER_virtual/kernel_wrs-sbc8548 = "linux-yocto"

# The 8548e has an E500v2 PowerPC core
DEFAULTTUNE = "ppce500v2"
require conf/machine/include/tune-ppce500v2.inc

MACHINE_FEATURES = "powerpc pci"

# The bootloader is U-Boot, we need a uImage file
KERNEL_IMAGETYPE = "uImage"

# Use the first (top) serial port for a console
SERIAL_CONSOLE = "115200 ttyS0"

# Generate a tar archive of the rootfs by default
IMAGE_FSTYPES ?= "tar.bz2"
```
